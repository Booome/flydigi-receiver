## ble-receiver/tests/unit/test_formatter_binary/testcase.yaml
```yaml
tests:
  ble_receiver.test_formatter_binary:
    platform_allow:
      - native_sim
    integration_platforms:
      - native_sim
    tags:
      - formatter
      - unit
```

## ble-receiver/tests/unit/test_formatter_text/testcase.yaml
```yaml
tests:
  ble_receiver.test_formatter_text:
    platform_allow:
      - native_sim
    integration_platforms:
      - native_sim
    tags:
      - formatter
      - unit
```
