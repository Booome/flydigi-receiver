## CMakeLists.txt
```
cmake_minimum_required(VERSION 3.20.0)
find_package(Zephyr REQUIRED HINTS $ENV{ZEPHYR_BASE})
project(ble_receiver)

# Devicetree overlay for dual CDC ACM
set(DTC_OVERLAY_FILE ${CMAKE_CURRENT_SOURCE_DIR}/app.overlay CACHE FILEPATH "Devicetree overlay" FORCE)

# Reuse Zephyr sample USB device initialization code
include(${ZEPHYR_BASE}/samples/subsys/usb/common/common.cmake)

FILE(GLOB app_sources src/*.c)
target_sources(app PRIVATE ${app_sources})
target_include_directories(app PRIVATE src)
```

## Kconfig
```
# Copyright (c) 2024 Flydigi Receiver Project
# SPDX-License-Identifier: Apache-2.0

choice OUTPUT_FORMAT
    prompt "Output data format"
    default OUTPUT_FORMAT_TEXT

config OUTPUT_FORMAT_TEXT
    bool "Text format (human-readable)"

config OUTPUT_FORMAT_BINARY
    bool "Binary format (16-byte frame)"
endchoice

choice OUTPUT_BACKEND
    prompt "Output backend"
    default OUTPUT_CDC

config OUTPUT_CDC
    bool "USB CDC ACM"

config OUTPUT_UART
    bool "UART TTL"

config OUTPUT_HID
    bool "USB HID (transparent passthrough)"
endchoice

# Source USB sample device descriptor options (SAMPLE_USBD_*)
source "samples/subsys/usb/common/Kconfig.sample_usbd"

source "Kconfig.zephyr"
```

## prj.conf
```kconfig
# Output configuration
CONFIG_OUTPUT_FORMAT_TEXT=y
CONFIG_OUTPUT_CDC=y

# USB CDC ACM (new USB stack)
CONFIG_USB_DEVICE_STACK_NEXT=y
CONFIG_USBD_CDC_ACM_CLASS=y
CONFIG_SERIAL=y
CONFIG_UART_LINE_CTRL=y
CONFIG_CDC_ACM_SERIAL_INITIALIZE_AT_BOOT=n

# Logging
CONFIG_LOG=y
CONFIG_USBD_LOG_LEVEL_ERR=y

# Sample USB device descriptors
CONFIG_SAMPLE_USBD_PID=0x0001
CONFIG_SAMPLE_USBD_PRODUCT="Flydigi BLE Receiver"
```

## src/main.c
```c
#include <zephyr/kernel.h>
#include "controller_state.h"
#include "formatter_text.h"
#include "formatter_binary.h"
#include "output.h"

#define SIM_INTERVAL_MS 500

static void sim_update(struct controller_state *s)
{
    static int16_t stick = 0;
    static uint8_t trig = 0;
    static uint16_t btn = 0;
    static int tick = 0;

    /* Sticks: step 4096, wraps through full int16_t range in 16 steps */
    stick += 4096;
    s->lx = stick;
    s->ly = -stick;
    s->rx = stick / 2;
    s->ry = -stick / 2;

    /* Triggers: step 32, wraps 0-255 in 8 steps */
    trig += 32;
    s->lt = trig;
    s->rt = 255 - trig;

    /* Buttons: rotate one bit every 4 ticks (bit 0 -> bit 14) */
    if (++tick % 4 == 0) {
        if (btn == 0) {
            btn = 1;
        } else {
            btn = (btn << 1) | (btn >> 15);
        }
    }
    s->buttons = btn;
}

int main(void)
{
    printk("BLE Receiver M1 - simulated data\n");

    output_init();

    struct controller_state state = {0};

    while (1) {
        sim_update(&state);

#if IS_ENABLED(CONFIG_OUTPUT_FORMAT_TEXT)
        char buf[FORMATTER_TEXT_MAX_LEN];
        size_t len = formatter_text_format(&state, buf, sizeof(buf));
        output_send((const uint8_t *)buf, len);
#elif IS_ENABLED(CONFIG_OUTPUT_FORMAT_BINARY)
        uint8_t buf[FORMATTER_BINARY_FRAME_LEN];
        size_t len = formatter_binary_format(&state, buf, sizeof(buf));
        output_send(buf, len);
#endif

        k_sleep(K_MSEC(SIM_INTERVAL_MS));
    }

    return 0;
}
```

## src/controller_state.h
```c
#ifndef CONTROLLER_STATE_H
#define CONTROLLER_STATE_H

#include <stdint.h>
#include <zephyr/sys/util.h>

/* Button bitmask definitions */
#define BTN_A       BIT(0)
#define BTN_B       BIT(1)
#define BTN_X       BIT(2)
#define BTN_Y       BIT(3)
#define BTN_LB      BIT(4)
#define BTN_RB      BIT(5)
#define BTN_BACK    BIT(6)
#define BTN_START   BIT(7)
#define BTN_GUIDE   BIT(8)
#define BTN_L3      BIT(9)
#define BTN_R3      BIT(10)
#define BTN_DUP     BIT(11)
#define BTN_DDOWN   BIT(12)
#define BTN_DLEFT   BIT(13)
#define BTN_DRIGHT  BIT(14)
/* bit 15 reserved */

/* Structured controller state - standard interface between layers */
struct controller_state {
    uint16_t buttons;      /* Button bitmask (see BTN_* above) */
    uint8_t  lt;           /* Left trigger  0-255 */
    uint8_t  rt;           /* Right trigger 0-255 */
    int16_t  lx;           /* Left stick X  -32768 ~ 32767 */
    int16_t  ly;           /* Left stick Y */
    int16_t  rx;           /* Right stick X */
    int16_t  ry;           /* Right stick Y */
    uint8_t  battery;      /* Battery level 0-100 */
};

#endif /* CONTROLLER_STATE_H */
```

## src/formatter_binary.c
```c
#include "formatter_binary.h"
#include <zephyr/sys/byteorder.h>

#define FRAME_HEAD1 0xAA
#define FRAME_HEAD2 0x55
#define FRAME_PAYLOAD_LEN 13

size_t formatter_binary_format(const struct controller_state *state,
                               uint8_t *buf, size_t buf_size)
{
    if (buf_size < FORMATTER_BINARY_FRAME_LEN) {
        return 0;
    }

    buf[0] = FRAME_HEAD1;
    buf[1] = FRAME_HEAD2;
    buf[2] = FRAME_PAYLOAD_LEN;

    sys_put_le16(state->buttons, &buf[3]);
    sys_put_le16((uint16_t)state->lx, &buf[5]);
    sys_put_le16((uint16_t)state->ly, &buf[7]);
    sys_put_le16((uint16_t)state->rx, &buf[9]);
    sys_put_le16((uint16_t)state->ry, &buf[11]);

    buf[13] = state->lt;
    buf[14] = state->rt;

    uint8_t checksum = 0;
    for (int i = 2; i <= 14; i++) {
        checksum += buf[i];
    }
    buf[15] = checksum;

    return FORMATTER_BINARY_FRAME_LEN;
}
```

## src/formatter_text.h
```c
#ifndef FORMATTER_TEXT_H
#define FORMATTER_TEXT_H

#include "controller_state.h"
#include <stddef.h>

#define FORMATTER_TEXT_MAX_LEN 65  /* actual output is 64 bytes + null */

/*
 * Format controller_state into a text line.
 * Format: LX:%06d,LY:%06d,RX:%06d,RY:%06d,BTN:%04x,LT:%03d,RT:%03d\r\n
 * Returns bytes written (excluding null terminator).
 * Returns 0 if buf_size is too small.
 * Actual output length is always 64 bytes.
 */
size_t formatter_text_format(const struct controller_state *state,
                             char *buf, size_t buf_size);

#endif /* FORMATTER_TEXT_H */
```

## src/output_cdc.c
```c
#include "output.h"

#include <zephyr/kernel.h>
#include <zephyr/device.h>
#include <zephyr/drivers/uart.h>
#include <zephyr/usb/usbd.h>
#include <zephyr/logging/log.h>
#include <sample_usbd.h>

LOG_MODULE_REGISTER(output_cdc, LOG_LEVEL_INF);

static const struct device *const cdc_dev =
    DEVICE_DT_GET_ONE(zephyr_cdc_acm_uart);
static struct usbd_context *usbd_ctx;
static bool cdc_ready;
static K_SEM_DEFINE(dtr_sem, 0, 1);

static void on_usbd_msg(struct usbd_context *const ctx,
                        const struct usbd_msg *msg)
{
    if (msg->type == USBD_MSG_CDC_ACM_CONTROL_LINE_STATE) {
        uint32_t dtr = 0;
        uart_line_ctrl_get(msg->dev, UART_LINE_CTRL_DTR, &dtr);
        if (dtr) {
            cdc_ready = true;
            k_sem_give(&dtr_sem);
            LOG_INF("DTR set, CDC ready");
        } else {
            cdc_ready = false;
            LOG_INF("DTR cleared, CDC not ready");
        }
    }
}

int output_init(void)
{
    if (!device_is_ready(cdc_dev)) {
        LOG_ERR("CDC ACM device not ready");
        return -ENODEV;
    }

    usbd_ctx = sample_usbd_init_device(on_usbd_msg);
    if (usbd_ctx == NULL) {
        LOG_ERR("Failed to init USB device");
        return -ENODEV;
    }

    int err = usbd_enable(usbd_ctx);
    if (err) {
        LOG_ERR("Failed to enable USB (err %d)", err);
        return err;
    }

    LOG_INF("USB CDC initialized, waiting for DTR");
    return 0;
}

int output_send(const uint8_t *data, size_t len)
{
    if (!cdc_ready) {
        return 0;
    }

    for (size_t i = 0; i < len; i++) {
        uart_poll_out(cdc_dev, data[i]);
    }
    return 0;
}
```
