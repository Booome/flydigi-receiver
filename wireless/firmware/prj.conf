## CMakeLists.txt
```
cmake_minimum_required(VERSION 3.20.0)
find_package(Zephyr REQUIRED HINTS $ENV{ZEPHYR_BASE})
project(ble_receiver)

# Devicetree overlay for dual CDC ACM
set(DTC_OVERLAY_FILE ${CMAKE_CURRENT_SOURCE_DIR}/app.overlay CACHE FILEPATH "Devicetree overlay" FORCE)

# Reuse Zephyr sample USB device initialization code
include(${ZEPHYR_BASE}/samples/subsys/usb/common/common.cmake)

target_sources(app PRIVATE
    src/main.c
    src/formatter_text.c
    src/formatter_binary.c
)

target_sources_ifdef(CONFIG_OUTPUT_CDC app PRIVATE src/output_cdc.c)
target_sources_ifdef(CONFIG_OUTPUT_UART app PRIVATE src/output_uart.c)

target_include_directories(app PRIVATE src)
```

## prj.conf
```kconfig
# Output configuration
CONFIG_OUTPUT_FORMAT_TEXT=y
CONFIG_OUTPUT_CDC=y

# USB CDC ACM (new USB stack)
CONFIG_USB_DEVICE_STACK_NEXT=y
CONFIG_USBD_CDC_ACM_CLASS=y
CONFIG_SERIAL=y
CONFIG_UART_LINE_CTRL=y
CONFIG_CDC_ACM_SERIAL_INITIALIZE_AT_BOOT=n

# Logging
CONFIG_LOG=y
CONFIG_USBD_LOG_LEVEL_ERR=y
CONFIG_CONSOLE=y
CONFIG_UART_CONSOLE=y
CONFIG_LOG_BACKEND_UART=y

# Sample USB device descriptors
CONFIG_SAMPLE_USBD_PID=0x0001
CONFIG_SAMPLE_USBD_PRODUCT="Flydigi BLE Receiver"
```

## app.overlay
```dts
/* Dual CDC ACM: Debug (console) + Data (formatter output) */

&board_cdc_acm_uart {
    label = "Flydigi-Debug";
};

&zephyr_udc0 {
    cdc_acm_data: cdc_acm_data {
        compatible = "zephyr,cdc-acm-uart";
        label = "Flydigi-Data";
    };
};
```

## src/main.c
```c
#include <zephyr/kernel.h>
#include "controller_state.h"
#include "formatter_text.h"
#include "formatter_binary.h"
#include "output.h"

#define SIM_INTERVAL_MS 500

static void sim_update(struct controller_state *s)
{
    static int16_t stick = 0;
    static uint8_t trig = 0;
    static uint16_t btn = 0;
    static int tick = 0;

    /* Sticks: step 4096, wraps through full int16_t range in 16 steps */
    stick += 4096;
    s->lx = stick;
    s->ly = -stick;
    s->rx = stick / 2;
    s->ry = -stick / 2;

    /* Triggers: step 32, wraps 0-255 in 8 steps */
    trig += 32;
    s->lt = trig;
    s->rt = 255 - trig;

    /* Buttons: rotate one bit every 4 ticks (bit 0 -> bit 14) */
    if (++tick % 4 == 0) {
        if (btn == 0) {
            btn = 1;
        } else {
            btn = (btn << 1) | (btn >> 15);
        }
    }
    s->buttons = btn;
}

int main(void)
{
    printk("BLE Receiver M2 - simulated data\n");

    output_init();

    struct controller_state state = {0};

    while (1) {
        sim_update(&state);

#if IS_ENABLED(CONFIG_OUTPUT_FORMAT_TEXT)
        char buf[FORMATTER_TEXT_MAX_LEN];
        size_t len = formatter_text_format(&state, buf, sizeof(buf));
        output_send((const uint8_t *)buf, len);
#elif IS_ENABLED(CONFIG_OUTPUT_FORMAT_BINARY)
        uint8_t buf[FORMATTER_BINARY_FRAME_LEN];
        size_t len = formatter_binary_format(&state, buf, sizeof(buf));
        output_send(buf, len);
#endif

        k_sleep(K_MSEC(SIM_INTERVAL_MS));
    }

    return 0;
}
```

## src/formatter_binary.h
```c
#ifndef FORMATTER_BINARY_H
#define FORMATTER_BINARY_H

#include "controller_state.h"
#include <stddef.h>
#include <stdint.h>

#define FORMATTER_BINARY_FRAME_LEN 16

size_t formatter_binary_format(const struct controller_state *state,
                               uint8_t *buf, size_t buf_size);

#endif /* FORMATTER_BINARY_H */
```

## src/formatter_text.c
```c
#include "formatter_text.h"
#include <stdio.h>

/*
 * Format: LX:%06d,LY:%06d,RX:%06d,RY:%06d,BTN:%04x,LT:%03d,RT:%03d\r\n
 * Max output: 60 bytes (excluding null)
 */
size_t formatter_text_format(const struct controller_state *state,
                             char *buf, size_t buf_size)
{
    if (buf_size < FORMATTER_TEXT_MAX_LEN) {
        return 0;
    }

    int len = snprintf(buf, buf_size,
        "LX:%06d,LY:%06d,RX:%06d,RY:%06d,BTN:%04x,LT:%03d,RT:%03d\r\n",
        state->lx, state->ly, state->rx, state->ry,
        state->buttons, state->lt, state->rt);

    if (len < 0) {
        return 0;
    }

    return (size_t)len;
}
```

## src/output.h
```c
#ifndef OUTPUT_H
#define OUTPUT_H

#include <stddef.h>
#include <stdint.h>

/*
 * Initialize the output backend.
 * Returns 0 on success, negative errno on failure.
 */
int output_init(void);

/*
 * Send data through the output backend.
 * Returns 0 on success (data is discarded if backend not ready).
 * Returns negative errno on error.
 */
int output_send(const uint8_t *data, size_t len);

#endif /* OUTPUT_H */
```

## src/output_cdc.c
```c
#include "output.h"

#include <zephyr/kernel.h>
#include <zephyr/device.h>
#include <zephyr/drivers/uart.h>
#include <zephyr/usb/usbd.h>
#include <zephyr/logging/log.h>
#include <sample_usbd.h>

LOG_MODULE_REGISTER(output_cdc, LOG_LEVEL_INF);

static const struct device *const cdc_dev =
    DEVICE_DT_GET(DT_NODELABEL(cdc_acm_data));
static struct usbd_context *usbd_ctx;
static bool cdc_ready;
static K_SEM_DEFINE(dtr_sem, 0, 1);

static void on_usbd_msg(struct usbd_context *const ctx,
                        const struct usbd_msg *msg)
{
    if (msg->type == USBD_MSG_CDC_ACM_CONTROL_LINE_STATE) {
        uint32_t dtr = 0;
        uart_line_ctrl_get(msg->dev, UART_LINE_CTRL_DTR, &dtr);
        if (dtr) {
            cdc_ready = true;
            k_sem_give(&dtr_sem);
            LOG_INF("DTR set, CDC ready");
        } else {
            cdc_ready = false;
            LOG_INF("DTR cleared, CDC not ready");
        }
    }
}

int output_init(void)
{
    if (!device_is_ready(cdc_dev)) {
        LOG_ERR("CDC ACM device not ready");
        return -ENODEV;
    }

    usbd_ctx = sample_usbd_init_device(on_usbd_msg);
    if (usbd_ctx == NULL) {
        LOG_ERR("Failed to init USB device");
        return -ENODEV;
    }

    int err = usbd_enable(usbd_ctx);
    if (err) {
        LOG_ERR("Failed to enable USB (err %d)", err);
        return err;
    }

    LOG_INF("USB CDC initialized, waiting for DTR");
    return 0;
}

int output_send(const uint8_t *data, size_t len)
{
    if (!cdc_ready) {
        return 0;
    }

    for (size_t i = 0; i < len; i++) {
        uart_poll_out(cdc_dev, data[i]);
    }
    return 0;
}
```

## src/output_uart.c
```c
#include "output.h"

#include <zephyr/kernel.h>
#include <zephyr/device.h>
#include <zephyr/drivers/uart.h>
#include <zephyr/usb/usbd.h>
#include <zephyr/logging/log.h>
#include <sample_usbd.h>

LOG_MODULE_REGISTER(output_uart, LOG_LEVEL_INF);

static const struct device *const uart_dev =
    DEVICE_DT_GET(DT_NODELABEL(uart0));

int output_init(void)
{
    if (!device_is_ready(uart_dev)) {
        LOG_ERR("UART device not ready");
        return -ENODEV;
    }

    struct usbd_context *usbd_ctx = sample_usbd_init_device(NULL);
    if (usbd_ctx == NULL) {
        LOG_ERR("Failed to init USB device for Debug CDC");
        return -ENODEV;
    }

    int err = usbd_enable(usbd_ctx);
    if (err) {
        LOG_ERR("Failed to enable USB (err %d)", err);
        return err;
    }

    LOG_INF("UART output initialized (P0.20 TX, 115200 baud)");
    return 0;
}

int output_send(const uint8_t *data, size_t len)
{
    for (size_t i = 0; i < len; i++) {
        uart_poll_out(uart_dev, data[i]);
    }
    return 0;
}
```
