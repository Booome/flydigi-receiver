## CMakeLists.txt
```
cmake_minimum_required(VERSION 3.14.1)
set(CMAKE_SYSTEM_NAME "Generic")

if(NOT DEFINED SDK_ROOT)
    if(DEFINED ENV{AI_BS21_SDK_PATH})
        set(SDK_ROOT "$ENV{AI_BS21_SDK_PATH}")
    else()
        set(SDK_ROOT "$ENV{HOME}/.local/Ai-BS21_SDK")
    endif()
endif()
if(NOT DEFINED BS21_TARGET)
    set(BS21_TARGET "bs21-n1100-rcu")
endif()
if(NOT DEFINED BS21_APP)
    set(BS21_APP "default")
endif()
find_package(Python3 COMPONENTS Interpreter REQUIRED)

set(ENV{PYTHONDONTWRITEBYTECODE} "1")
# build-time scripts are launched by make and do not inherit the env above,
# so wrap the interpreter to keep the SDK tree free of __pycache__ writes.
set(Python3_EXECUTABLE "${CMAKE_COMMAND}" "-E" "env" "PYTHONDONTWRITEBYTECODE=1" "${Python3_EXECUTABLE}")

set(CONFIG_FILE "${CMAKE_CURRENT_BINARY_DIR}/sdk-config.cmake")
execute_process(
    COMMAND ${Python3_EXECUTABLE} ${CMAKE_CURRENT_SOURCE_DIR}/scripts/gen-config.py
            ${SDK_ROOT} ${BS21_TARGET} ${CONFIG_FILE} ${BS21_APP}
    RESULT_VARIABLE gen_result)
if(NOT gen_result EQUAL 0)
    message(FATAL_ERROR "gen-config.py failed: ${gen_result}")
endif()
include(${CONFIG_FILE})

# global compile flags for all apps
string(REPLACE ";" " " _CCFLAGS "${CCFLAGS}")
if(NOT "${_CCFLAGS}" MATCHES "Wno-unused-parameter")
    set(CCFLAGS "${CCFLAGS};-Wno-unused-parameter" CACHE INTERNAL "" FORCE)
endif()
if(NOT "${_CCFLAGS}" MATCHES "Wno-unused-variable")
    set(CCFLAGS "${CCFLAGS};-Wno-unused-variable" CACHE INTERNAL "" FORCE)
endif()
if(NOT "${_CCFLAGS}" MATCHES "Wno-unused-const-variable")
    set(CCFLAGS "${CCFLAGS};-Wno-unused-const-variable" CACHE INTERNAL "" FORCE)
endif()

set(ROOT_DIR "${SDK_ROOT}")
set(CMAKE_DIR "${SDK_ROOT}/build/cmake")
set(BIN_DIR "${SDK_ROOT}/interim_binary")
set(CMAKE_TOOLCHAIN_FILE "${CMAKE_CURRENT_SOURCE_DIR}/toolchain.cmake")
set(PKG_TARGET_NAME ${BS21_TARGET})
string(REPLACE "-" "_" BUILD_TARGET_NAME ${BS21_TARGET})
list(APPEND RAM_COMPONENT rom_callback)
list(APPEND DEFINES _PRE_FEATURE_VENEER_ROM)
set(BUILD_ROM_CALLBACK False)

include(${SDK_ROOT}/build/cmake/build_function.cmake)
include(${SDK_ROOT}/build/cmake/global_variable.cmake)
include(${SDK_ROOT}/build/cmake/build_script.cmake)
include(${SDK_ROOT}/build/cmake/build_command.cmake)
include(${SDK_ROOT}/build/cmake/build_hso_database.cmake)
include(${SDK_ROOT}/build/cmake/build_component.cmake)
include(${SDK_ROOT}/build/cmake/build_sdk.cmake)

project(${CHIP}_CFBB C ASM CXX)
set(MODULE_NAME "pf")
set(AUTO_DEF_FILE_ID TRUE)
set(AUTO_DEF_MODULE_ID TRUE)
set(CMAKE_CXX_IMPLICIT_INCLUDE_DIRECTORIES "")
file(REMOVE ${CMAKE_BINARY_DIR}/auto_gen_libfunc.lds)

set(TARGET_COMPONENT "${RAM_COMPONENT}" "${ROM_COMPONENT}")
set(TARGET_NAME ${BIN_NAME})
file(WRITE ${PROJECT_BINARY_DIR}/temp/__null___.c "int __null___(void) {return 0;}")
add_executable(${BIN_NAME} ${PROJECT_BINARY_DIR}/temp/__null___.c)
set_target_properties(${BIN_NAME} PROPERTIES RUNTIME_OUTPUT_NAME ${BIN_NAME}.elf)
target_compile_options(${BIN_NAME} PRIVATE "${CCFLAGS}")

include(${SDK_ROOT}/build/cmake/build_rom_callback.cmake)
if(${BUILD_ROM_CALLBACK})
    build_rom_callback()
endif()

string(REPLACE "-" "_" BS21_TARGET_CFG ${BS21_TARGET})
execute_process(
    COMMAND ${Python3_EXECUTABLE} ${SDK_ROOT}/build/script/usr_config.py
            --command savemenuconfig --chip ${CHIP} --core ${CORE}
            --target ${BS21_TARGET} --output ${CMAKE_BINARY_DIR}
    WORKING_DIRECTORY ${SDK_ROOT}
    RESULT_VARIABLE mconfig_result)
if(NOT mconfig_result EQUAL 0)
    message(FATAL_ERROR "mconfig failed")
endif()

set(KCONFIG_PATH "${SDK_ROOT}/build/config/target_config/${CHIP}/menuconfig/${CORE}/${BS21_TARGET_CFG}.config")
if(EXISTS ${KCONFIG_PATH})
    KCONFIG_GET_PARAMS(${KCONFIG_PATH})
    set(USE_KCONFIG True)
    # bs2x_sample_config.cmake normally appends these, but its Kconfig-derived
    # variables are not visible here; ensure the log region is reserved.
    if(DEFINED CONFIG_SUPPORT_LOG_THREAD)
        list(APPEND DEFINES CONFIG_SUPPORT_LOG_THREAD)
    endif()
endif()

add_subdirectory(${SDK_ROOT}/application/bs21/standard ${CMAKE_BINARY_DIR}/sdk/standard)
add_subdirectory(${SDK_ROOT}/kernel ${CMAKE_BINARY_DIR}/sdk/kernel)
add_subdirectory(${SDK_ROOT}/drivers ${CMAKE_BINARY_DIR}/sdk/drivers)
add_subdirectory(${SDK_ROOT}/middleware ${CMAKE_BINARY_DIR}/sdk/middleware)
add_subdirectory(${SDK_ROOT}/open_source ${CMAKE_BINARY_DIR}/sdk/open_source)
add_subdirectory(apps/${BS21_APP})
add_subdirectory(sdk-compat)

add_path_with_alias_if_exist(${SDK_ROOT}/protocol sdk/protocol)
add_path_with_alias_if_exist(${SDK_ROOT}/test sdk/test)
add_path_with_alias_if_exist(${SDK_ROOT}/include sdk/include)
add_path_with_alias_if_exist(${SDK_ROOT}/vendor sdk/vendor)

include(${SDK_ROOT}/build/cmake/open_source.cmake)
include(${SDK_ROOT}/build/cmake/build_linker.cmake)

# Apps linked against a patched stack-library profile (lib_profile ending
# in "-decoy", see tools/patch_gle_decoy.py) refresh the patch on every
# build so a plain configure+build always yields correct firmware.
if(CONFIG_SLE_BLE_SUPPORT MATCHES "-decoy")
    add_custom_target(bs21_patch_stack_libs
        COMMAND ${Python3_EXECUTABLE}
                ${CMAKE_CURRENT_SOURCE_DIR}/tools/patch_gle_decoy.py
        COMMENT "bs21: refreshing patched stack libs (sle-peripheral-decoy)"
        VERBATIM)
    add_dependencies(${TARGET_NAME} bs21_patch_stack_libs)
endif()

if (NOT DEFINED ROM_COMPONENT)
add_custom_target(GENERAT_BIN ALL
    COMMAND ${CMAKE_OBJCOPY} --gap-fill 0xFF -O binary -R .fls_loader_ram -R .logstr -R .ARM -R .ARM ${BIN_NAME}.elf ${BIN_NAME}.bin
    COMMENT "post_build:gen bin file"
    WORKING_DIRECTORY ${PROJECT_BINARY_DIR}
    DEPENDS ${TARGET_NAME}
)
else()
add_custom_target(GENERAT_BIN ALL
    COMMAND ${CMAKE_OBJCOPY} --gap-fill 0xFF -O binary -R .logstr -R .ARM.exidx -R .ARM.extab -R .*_romtext ${TARGET_NAME}.elf ${TARGET_NAME}.bin
    COMMAND ${CMAKE_OBJCOPY} --gap-fill 0xFF -O binary -j .*_romtext ${TARGET_NAME}.elf ${TARGET_NAME}_rom.bin
    COMMENT "post_build:gen rom and ram bin file"
    WORKING_DIRECTORY ${PROJECT_BINARY_DIR}
    DEPENDS ${TARGET_NAME}
)
endif()

include(${SDK_ROOT}/build/cmake/build_ssb.cmake)
include(${SDK_ROOT}/build/cmake/build_elf_info.cmake)
set(PACKAGE_DEPENDS ${BIN_NAME} GENERAT_NVBIN GENERAT_PARTITION
        COPY_FLASHBOOT_BIN COPY_LOADERBOOT_BIN)
if (EXISTS ${SDK_ROOT}/build/config/target_config/${CHIP}/sign_config/${BUILD_TARGET_NAME}.cfg)
    set(BS21_SIGN_DIR "${SDK_ROOT}/output/${CHIP}/${CORE}/${PKG_TARGET_NAME}")
    if(TARGET GENERAT_ROM_PATCH)
        set(SIGNBIN_DEPS GENERAT_BIN GENERAT_ROM_PATCH)
    else()
        set(SIGNBIN_DEPS GENERAT_BIN)
    endif()
    add_custom_target(GENERAT_SIGNBIN ALL
        COMMAND ${CMAKE_COMMAND} -E make_directory ${BS21_SIGN_DIR}
        COMMAND ${CMAKE_COMMAND} -E copy_if_different ${PROJECT_BINARY_DIR}/${BIN_NAME}.bin ${BS21_SIGN_DIR}/${BIN_NAME}.bin
        COMMAND ${SIGN_TOOL} 0 ${SDK_ROOT}/build/config/target_config/${CHIP}/sign_config/${BUILD_TARGET_NAME}.cfg
        COMMENT "sign file:gen boot sign file"
        WORKING_DIRECTORY ${BS21_SIGN_DIR}
        DEPENDS ${SIGNBIN_DEPS}
    )
    list(APPEND PACKAGE_DEPENDS GENERAT_SIGNBIN)
    if(${GEN_SEC_BIN} STREQUAL "True")
        if (EXISTS ${COMPILER_ROOT}/lib/sec/${IMAGE_VERSION}/libsec_image.so)
            execute_process(COMMAND ${CMAKE_COMMAND} -E copy
                ${COMPILER_ROOT}/lib/sec/${IMAGE_VERSION}/libsec_image.so
                ${COMPILER_ROOT}/lib/sec/libsec_image.so)
        endif()
        add_custom_target(GENERAT_SEC_IMAGE ALL
            COMMAND ${CMAKE_OBJCOPY} --enable_sec ${BS21_SIGN_DIR}/${BIN_NAME}_sign.bin
            COMMENT "enable sec image"
            WORKING_DIRECTORY ${COMPILER_ROOT}/bin
            DEPENDS GENERAT_SIGNBIN
        )
        list(APPEND PACKAGE_DEPENDS GENERAT_SEC_IMAGE)
    endif()
endif()
include(${SDK_ROOT}/build/cmake/build_nv_bin.cmake)
include(${SDK_ROOT}/build/cmake/build_partition_bin.cmake)
include(${SDK_ROOT}/build/cmake/build_boot_bin_cp.cmake)

create_hso_db()
generate_project_file()

add_custom_target(package ALL
    COMMAND ${Python3_EXECUTABLE} ${SDK_ROOT}/tools/pkg/packet.py
            ${CHIP} ${BS21_TARGET} NO_BOOT_BACKUP ${SECTOR_CFG}
    COMMAND ${CMAKE_COMMAND} -E copy_directory ${SDK_ROOT}/output/${CHIP}/fwpkg/${BS21_TARGET} ${PROJECT_BINARY_DIR}
    # packet.py hardcodes a write into a tracked SDK file; restore it to keep the SDK tree clean
    COMMAND git -C ${SDK_ROOT} checkout -- tools/pkg/fwpkg/${CHIP}/${CHIP}_all.fwpkg
    # gen-config.py (via SDK enviroment.rm_pyc) removes tracked pycache; restore it
    COMMAND git -C ${SDK_ROOT} checkout -- build/config/target_config/${CHIP}/fota/__pycache__/fota_format_st.cpython-39.pyc
    WORKING_DIRECTORY ${SDK_ROOT}
    DEPENDS ${PACKAGE_DEPENDS})
```

## prj.conf
```kconfig
CONFIG_DEBUG=y
CONFIG_UART=y
CONFIG_UART0=y

CONFIG_SUPPORT_SLE=y
CONFIG_SUPPORT_SLE_CENTRAL=y
CONFIG_SUPPORT_SLE_PERIPHERAL=y
```

## src/main.c
```c
#include <stdio.h>
#include "sle_manager.h"

static void on_scan_result(const sle_scan_result_t *result)
{
    printf("[SCAN] device: ");
    for (int i = 0; i < 6; i++) {
        printf("%02X", result->addr[i]);
        if (i < 5) printf(":");
    }
    printf(" RSSI=%d data_len=%d\n", result->rssi, result->data_len);
    if (result->data_len > 0) {
        printf("[SCAN]   data: ");
        for (int i = 0; i < result->data_len; i++) {
            printf("%02X ", result->data[i]);
        }
        printf("\n");
    }
}

int main(void)
{
    printf("BS21 G-Node (Seek)\n");
    sle_init();
    sle_set_scan_callback(on_scan_result);
    sle_start_seek();
    while (1) {
        // SLE stack event loop
    }
    return 0;
}
```

## src/bs21_util.c
```c
#include "bs21_util.h"
#include "pinctrl.h"
#include "gpio.h"
#include "chip_io.h"
#include "string.h"
#include "errcode.h"
#include "sle_common.h"
#include "sle_device_discovery.h"
#include "soc_osal.h"

/*
 * Initialize the reset button (S_MGPIO21).
 *
 * Source: SDK demo (application/demo/demo.c), function bs21_rst().
 * The function configures S_MGPIO21 as a pull-up input and performs two
 * vendor-specific register writes (0x5702C51C) that are not exposed by the
 * SDK headers. These writes come directly from the SDK demo.
 *
 * Necessity: verified on hardware. Removing this call causes the reset
 * button (S_MGPIO21) to stop working, confirming that the pin must be
 * configured as a pull-up input with the two vendor register bits set.
 * Do not remove.
 */
void bs21_rst(void)
{
    uapi_pin_set_mode(S_MGPIO21, (pin_mode_t)HAL_PIO_FUNC_GPIO);
    uapi_gpio_set_dir(S_MGPIO21, GPIO_DIRECTION_INPUT);
    uapi_pin_set_pull(S_MGPIO21, PIN_PULL_UP);
    reg16_setbits(0x5702C51C, 4, 5, 21);
    reg16_clrbit(0x5702C51C, 0);
}

void sle_setup_set_local_addr(void)
{
    sle_addr_t la = { 0 };
    la.type = SLE_ADDRESS_TYPE_PUBLIC;
    la.addr[0] = 0xaa; la.addr[1] = 0xbb; la.addr[2] = 0xcc;
    la.addr[3] = 0xdd; la.addr[4] = 0xee; la.addr[5] = 0x02;
    if (sle_set_local_addr(&la) == ERRCODE_SUCC) {
        osal_printk("[conn] local addr set to aa:bb:cc:dd:ee:02\r\n");
    }
}

void sle_scan_start(void)
{
    sle_seek_param_t param = { 0 };
    errcode_t rc;
    param.own_addr_type = 0;
    param.filter_duplicates = 0;
    param.seek_filter_policy = 0;
    param.seek_phys = 1;
    param.seek_type[0] = 1;
    param.seek_interval[0] = 100;
    param.seek_window[0] = 100;
    rc = sle_set_seek_param(&param);
    if (rc != ERRCODE_SUCC) {
        osal_printk("sle_set_seek_param fail: 0x%x\r\n", rc);
        return;
    }
    rc = sle_start_seek();
    if (rc != ERRCODE_SUCC) {
        osal_printk("sle_start_seek fail: 0x%x\r\n", rc);
    }
}
```

## src/controller_state.h
```c
#ifndef CONTROLLER_STATE_H
#define CONTROLLER_STATE_H

#include <stdint.h>

#define BIT(n) (1UL << (n))

/* Button bitmask definitions */
#define BTN_A       BIT(0)
#define BTN_B       BIT(1)
#define BTN_X       BIT(2)
#define BTN_Y       BIT(3)
#define BTN_LB      BIT(4)
#define BTN_RB      BIT(5)
#define BTN_BACK    BIT(6)
#define BTN_START   BIT(7)
#define BTN_GUIDE   BIT(8)
#define BTN_L3      BIT(9)
#define BTN_R3      BIT(10)
#define BTN_DUP     BIT(11)
#define BTN_DDOWN   BIT(12)
#define BTN_DLEFT   BIT(13)
#define BTN_DRIGHT  BIT(14)
/* bit 15 reserved */

/* Structured controller state - standard interface between layers */
struct controller_state {
    uint16_t buttons;      /* Button bitmask (see BTN_* above) */
    uint8_t  lt;           /* Left trigger  0-255 */
    uint8_t  rt;           /* Right trigger 0-255 */
    int16_t  lx;           /* Left stick X  -32768 ~ 32767 */
    int16_t  ly;           /* Left stick Y */
    int16_t  rx;           /* Right stick X */
    int16_t  ry;           /* Right stick Y */
    uint8_t  battery;      /* Battery level 0-100 */
};

#endif /* CONTROLLER_STATE_H */
```

## src/scan_table.c
```c
#include "scan_table.h"
#include "soc_osal.h"
#include "securec.h"

static scan_device_t g_scan_table[SCAN_TABLE_SIZE] = { 0 };
static bool g_table_full = false;

scan_device_t *scan_table_find(const sle_addr_t *addr)
{
    for (uint8_t i = 0; i < SCAN_TABLE_SIZE; i++) {
        if (g_scan_table[i].used &&
            memcmp(g_scan_table[i].addr.addr, addr->addr, SLE_ADDR_LEN) == 0) {
            return &g_scan_table[i];
        }
    }
    return NULL;
}

scan_device_t *scan_table_add(const sle_addr_t *addr)
{
    for (uint8_t i = 0; i < SCAN_TABLE_SIZE; i++) {
        if (!g_scan_table[i].used) {
            g_scan_table[i].used = 1;
            memcpy_s(g_scan_table[i].addr.addr, SLE_ADDR_LEN, addr->addr, SLE_ADDR_LEN);
            return &g_scan_table[i];
        }
    }
    g_table_full = true;
    return NULL;
}

void scan_table_print(void)
{
    uint8_t n = 0;
    for (uint8_t i = 0; i < SCAN_TABLE_SIZE; i++) {
        if (g_scan_table[i].used) {
            n++;
        }
    }
    osal_printk("[scan] devices:%u\r\n", n);
    for (uint8_t i = 0; i < SCAN_TABLE_SIZE; i++) {
        if (g_scan_table[i].used) {
            osal_printk("  %u) %02x:%02x:%02x:%02x:%02x:%02x rssi:%d cnt:%u\r\n",
                        i,
                        g_scan_table[i].addr.addr[0], g_scan_table[i].addr.addr[1],
                        g_scan_table[i].addr.addr[2], g_scan_table[i].addr.addr[3],
                        g_scan_table[i].addr.addr[4], g_scan_table[i].addr.addr[5],
                        g_scan_table[i].rssi, g_scan_table[i].count);
        }
    }
    if (g_table_full) {
        osal_printk("[scan] table full\r\n");
    }
}

scan_device_t *scan_table_best(void)
{
    scan_device_t *best = NULL;
    for (uint8_t i = 0; i < SCAN_TABLE_SIZE; i++) {
        if (g_scan_table[i].used &&
            (best == NULL || g_scan_table[i].rssi > best->rssi)) {
            best = &g_scan_table[i];
        }
    }
    return best;
}

void scan_table_reset(void)
{
    for (uint8_t i = 0; i < SCAN_TABLE_SIZE; i++) {
        g_scan_table[i].used = 0;
        g_scan_table[i].count = 0;
        g_scan_table[i].rssi = 0;
    }
    g_table_full = false;
}
```

## src/scan_table.h
```c
#ifndef SCAN_TABLE_H
#define SCAN_TABLE_H

#include "sle_common.h"
#include <stdbool.h>
#include <stdint.h>

#define SCAN_TABLE_SIZE 32

typedef struct {
  sle_addr_t addr;
  int8_t rssi;
  uint32_t count;
  uint8_t used;
} scan_device_t;

scan_device_t *scan_table_find(const sle_addr_t *addr);
scan_device_t *scan_table_add(const sle_addr_t *addr);
void scan_table_print(void);
scan_device_t *scan_table_best(void);
void scan_table_reset(void);
bool scan_table_full(void);

#endif /* SCAN_TABLE_H */
```

## src/sle_manager.c
```c
#include "sle_manager.h"
#include <stdio.h>
#include <string.h>

static scan_result_cb_t g_scan_cb = NULL;
static connect_state_cb_t g_connect_cb = NULL;
static pair_complete_cb_t g_pair_cb = NULL;
static ssap_data_cb_t g_data_cb = NULL;

void sle_init(void)
{
    printf("[SLE] init\n");
}

void sle_start_announce(void)
{
    printf("[SLE] announce started\n");
}

void sle_stop_announce(void)
{
    printf("[SLE] announce stopped\n");
}

void sle_start_seek(void)
{
    printf("[SLE] seek started\n");
}

void sle_stop_seek(void)
{
    printf("[SLE] seek stopped\n");
}

void sle_connect(const uint8_t addr[6])
{
    printf("[SLE] connect to %02X:%02X:%02X:%02X:%02X:%02X\n",
           addr[0], addr[1], addr[2], addr[3], addr[4], addr[5]);
}

void sle_disconnect(uint8_t conn_id)
{
    printf("[SLE] disconnect conn_id=%u\n", conn_id);
}

void sle_pair(uint8_t conn_id)
{
    printf("[SLE] pair conn_id=%u\n", conn_id);
}

void sle_send(uint8_t conn_id, const uint8_t *data, uint16_t len)
{
    printf("[SLE] send conn_id=%u len=%u\n", conn_id, len);
}

void sle_set_scan_callback(scan_result_cb_t cb) { g_scan_cb = cb; }
void sle_set_connect_callback(connect_state_cb_t cb) { g_connect_cb = cb; }
void sle_set_pair_callback(pair_complete_cb_t cb) { g_pair_cb = cb; }
void sle_set_data_callback(ssap_data_cb_t cb) { g_data_cb = cb; }
```

## src/sle_manager.h
```c
#ifndef SLE_MANAGER_H
#define SLE_MANAGER_H

#include <stdint.h>

typedef struct {
    uint8_t addr[6];
    int8_t rssi;
    uint8_t data_len;
    uint8_t data[31];
} sle_scan_result_t;

typedef void (*scan_result_cb_t)(const sle_scan_result_t *result);
typedef void (*connect_state_cb_t)(uint8_t conn_id, uint8_t state, uint8_t reason);
typedef void (*pair_complete_cb_t)(uint8_t conn_id, uint8_t status);
typedef void (*ssap_data_cb_t)(uint8_t conn_id, const uint8_t *data, uint16_t len);

void sle_init(void);
void sle_start_announce(void);
void sle_stop_announce(void);
void sle_start_seek(void);
void sle_stop_seek(void);
void sle_connect(const uint8_t addr[6]);
void sle_disconnect(uint8_t conn_id);
void sle_pair(uint8_t conn_id);
void sle_send(uint8_t conn_id, const uint8_t *data, uint16_t len);
void sle_set_scan_callback(scan_result_cb_t cb);
void sle_set_connect_callback(connect_state_cb_t cb);
void sle_set_pair_callback(pair_complete_cb_t cb);
void sle_set_data_callback(ssap_data_cb_t cb);

#endif
```
